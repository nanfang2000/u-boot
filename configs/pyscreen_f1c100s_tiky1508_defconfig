## configs/pyscreen_f1c100s_tiky1508_defconfig
```kconfig
CONFIG_ARM=y
CONFIG_ARCH_SUNXI=y
CONFIG_MACH_SUNIV=y
CONFIG_DRAM_CLK=156
CONFIG_DRAM_ZQ=0
CONFIG_VIDEO_SUNXI=y
CONFIG_VIDEO=y
CONFIG_CFB_CONSOLE=y
CONFIG_HIDE_LOGO_VERSION=y
CONFIG_DEFAULT_DEVICE_TREE="suniv-f1c100s-licheepi-nano"
CONFIG_SPL=y
# CONFIG_SPL_DM_SERIAL is not set
CONFIG_LCD_MODEL="TK043F1508"
# Initialize LCD panel with SPI
CONFIG_VIDEO_LCD_PANEL_SPI=y
CONFIG_SYS_CLK_FREQ=720000000
CONFIG_VIDEO_LCD_MODE="x:480,y:800,depth:18,pclk_khz:33000,le:3,ri:59,up:3,lo:12,hs:1,vs:1,sync:0,vmode:0"
CONFIG_VIDEO_LCD_BL_PWM_ACTIVE_LOW=n
CONFIG_VIDEO_LCD_BL_PWM="PE6"
CONFIG_DM_GPIO=n
```
